## sdkconfig.defaults
```kconfig
CONFIG_IDF_TARGET="esp32s3"

CONFIG_ESPTOOLPY_FLASHSIZE_4MB=y
CONFIG_ESPTOOLPY_FLASHMODE_DIO=y
CONFIG_ESPTOOLPY_FLASHFREQ_80M=y

CONFIG_PARTITION_TABLE_CUSTOM=y
CONFIG_PARTITION_TABLE_CUSTOM_FILENAME="partitions.csv"

CONFIG_ESP_DEFAULT_CPU_FREQ_MHZ_240=y

CONFIG_SPIRAM=y
CONFIG_SPIRAM_MODE_QUAD=y
CONFIG_SPIRAM_SPEED_80M=y
CONFIG_SPIRAM_MALLOC_RESERVE_INTERNAL=65536

# CONFIG_CHIP_MEM_ALLOC_MODE_DEFAULT is not set
CONFIG_CHIP_MEM_ALLOC_MODE_EXTERNAL=y
CONFIG_CHIP_TASK_STACK_SIZE=12288
# CONFIG_ESP_MATTER_MEM_ALLOC_MODE_DEFAULT is not set
CONFIG_ESP_MATTER_MEM_ALLOC_MODE_EXTERNAL=y

# CONFIG_ESP_MATTER_ENABLE_OPENTHREAD is not set
# CONFIG_ENABLE_ESP32_FACTORY_DATA_PROVIDER is not set
# CONFIG_ENABLE_ESP32_DEVICE_INSTANCE_INFO_PROVIDER is not set
CONFIG_EXAMPLE_DAC_PROVIDER=y
CONFIG_EXAMPLE_COMMISSIONABLE_DATA_PROVIDER=y
# CONFIG_EXAMPLE_DEVICE_INSTANCE_INFO_PROVIDER is not set
CONFIG_CUSTOM_DEVICE_INSTANCE_INFO_PROVIDER=y

CONFIG_DEVICE_VENDOR_ID=0xFFF1
CONFIG_DEVICE_PRODUCT_ID=0x8001

CONFIG_ENABLE_TEST_SETUP_PARAMS=y
CONFIG_CHIP_ENABLE_PAIRING_AUTOSTART=y
CONFIG_ENABLE_WIFI_STATION=y

# CONFIG_ENABLE_OTA_REQUESTOR is not set
# CONFIG_ENABLE_CHIP_SHELL is not set
# CONFIG_ENABLE_SNTP_TIME_SYNC is not set
```
